OUTPUT_FORMAT(pei-i386)
OUTPUT(section.pe)

_atexit  = 0xA8211E;
__Znwj   = 0xA825B9;
__ZdlPvj = 0x958C40;
"__imp__GetModuleHandleA@4" = 0xC0F378;
"__imp__GetProcAddress@8" = 0xC0F48C;
"__imp__AdjustTokenPrivileges" = 0x00C0F000;
"__imp__OpenProcessToken" = 0x00C0F004;
"__imp__RegCreateKeyExA" = 0x00C0F008;
"__imp__RegQueryValueExA" = 0x00C0F00C;
"__imp__RegOpenKeyExA" = 0x00C0F010;
"__imp__RegCloseKey" = 0x00C0F014;
"__imp__RegSetValueExA" = 0x00C0F018;
"__imp__RegQueryValueExW" = 0x00C0F01C;
"__imp__RegOpenKeyExW" = 0x00C0F020;
"__imp__GetUserNameW" = 0x00C0F024;
"__imp__LookupPrivilegeValueW" = 0x00C0F028;
"__imp__RegOpenKeyW" = 0x00C0F02C;
"__imp__RegQueryInfoKeyW" = 0x00C0F030;
"__imp__RegCreateKeyW" = 0x00C0F034;
"__imp__RegDeleteValueW" = 0x00C0F038;
"__imp__RegEnumValueW" = 0x00C0F03C;
"__imp__RegEnumKeyW" = 0x00C0F040;
"__imp__RegSetValueExW" = 0x00C0F044;
"__imp__RegDeleteKeyW" = 0x00C0F048;
"__imp__LookupPrivilegeValueA" = 0x00C0F04C;
"__imp__InitCommonControls" = 0x00C0F068;
"__imp__ImageList_Remove" = 0x00C0F06C;
"__imp__ImageList_Draw" = 0x00C0F070;
"__imp__ImageList_SetBkColor" = 0x00C0F074;
"__imp__ImageList_Add" = 0x00C0F078;
"__imp__ImageList_Replace" = 0x00C0F07C;
"__imp__ImageList_Create" = 0x00C0F080;
"__imp__CreateStatusWindowW" = 0x00C0F084;
"__imp__ImageList_SetDragCursorImage" = 0x00C0F088;
"__imp__ImageList_BeginDrag" = 0x00C0F08C;
"__imp__ImageList_EndDrag" = 0x00C0F090;
"__imp__ImageList_DragMove" = 0x00C0F094;
"__imp__ImageList_DragEnter" = 0x00C0F098;
"__imp__ImageList_DragLeave" = 0x00C0F09C;
"__imp__ImageList_Destroy" = 0x00C0F0A0;
"__imp__ImageList_ReplaceIcon" = 0x00C0F0A4;
"__imp__ImageList_GetIconSize" = 0x00C0F0A8;
"__imp__CreateUpDownControl" = 0x00C0F0AC;
"__imp__ImageList_AddMasked" = 0x00C0F0B0;
"__imp__ImageList_GetImageCount" = 0x00C0F0B4;
"__imp__DirectSoundCreate" = 0x00C0F0BC;
"__imp__Polyline" = 0x00C0F0C4;
"__imp__Rectangle" = 0x00C0F0C8;
"__imp__RoundRect" = 0x00C0F0CC;
"__imp__Ellipse" = 0x00C0F0D0;
"__imp__TextOutW" = 0x00C0F0D4;
"__imp__SetBrushOrgEx" = 0x00C0F0D8;
"__imp__SetROP2" = 0x00C0F0DC;
"__imp__SetWindowOrgEx" = 0x00C0F0E0;
"__imp__SetViewportOrgEx" = 0x00C0F0E4;
"__imp__SetWindowExtEx" = 0x00C0F0E8;
"__imp__SetViewportExtEx" = 0x00C0F0EC;
"__imp__MaskBlt" = 0x00C0F0F0;
"__imp__CreateHatchBrush" = 0x00C0F0F4;
"__imp__CreatePatternBrush" = 0x00C0F0F8;
"__imp__ExtCreatePen" = 0x00C0F0FC;
"__imp__CreateDIBitmap" = 0x00C0F100;
"__imp__CreateDCW" = 0x00C0F104;
"__imp__SetDIBits" = 0x00C0F108;
"__imp__CreateICW" = 0x00C0F10C;
"__imp__GetTextExtentPoint32W" = 0x00C0F110;
"__imp__CreateBitmapIndirect" = 0x00C0F114;
"__imp__SetPolyFillMode" = 0x00C0F118;
"__imp__CopyEnhMetaFileW" = 0x00C0F11C;
"__imp__DeleteEnhMetaFile" = 0x00C0F120;
"__imp__GetEnhMetaFileHeader" = 0x00C0F124;
"__imp__CreateEnhMetaFileW" = 0x00C0F128;
"__imp__SetMetaFileBitsEx" = 0x00C0F12C;
"__imp__GetWinMetaFileBits" = 0x00C0F130;
"__imp__PlayEnhMetaFile" = 0x00C0F134;
"__imp__CloseEnhMetaFile" = 0x00C0F138;
"__imp__SetWinMetaFileBits" = 0x00C0F13C;
"__imp__GetMetaFileBitsEx" = 0x00C0F140;
"__imp__Polygon" = 0x00C0F144;
"__imp__SetPixel" = 0x00C0F148;
"__imp__Pie" = 0x00C0F14C;
"__imp__Arc" = 0x00C0F150;
"__imp__ExtFloodFill" = 0x00C0F154;
"__imp__SelectClipRgn" = 0x00C0F158;
"__imp__ExtSelectClipRgn" = 0x00C0F15C;
"__imp__GetClipBox" = 0x00C0F160;
"__imp__GetTextColor" = 0x00C0F164;
"__imp__GetBkColor" = 0x00C0F168;
"__imp__TranslateCharsetInfo" = 0x00C0F16C;
"__imp__GetPaletteEntries" = 0x00C0F170;
"__imp__PatBlt" = 0x00C0F174;
"__imp__CreatePen" = 0x00C0F178;
"__imp__MoveToEx" = 0x00C0F17C;
"__imp__DeleteObject" = 0x00C0F180;
"__imp__CreateBitmap" = 0x00C0F184;
"__imp__CreateCompatibleDC" = 0x00C0F188;
"__imp__GetTextMetricsW" = 0x00C0F18C;
"__imp__GetKerningPairsW" = 0x00C0F190;
"__imp__SetTextAlign" = 0x00C0F194;
"__imp__CreateCompatibleBitmap" = 0x00C0F198;
"__imp__StretchDIBits" = 0x00C0F19C;
"__imp__SetDIBitsToDevice" = 0x00C0F1A0;
"__imp__GetBitmapBits" = 0x00C0F1A4;
"__imp__ExtCreateRegion" = 0x00C0F1A8;
"__imp__GetRegionData" = 0x00C0F1AC;
"__imp__CreatePolygonRgn" = 0x00C0F1B0;
"__imp__CombineRgn" = 0x00C0F1B4;
"__imp__GetRgnBox" = 0x00C0F1B8;
"__imp__PtInRegion" = 0x00C0F1BC;
"__imp__RectInRegion" = 0x00C0F1C0;
"__imp__OffsetRgn" = 0x00C0F1C4;
"__imp__CreatePalette" = 0x00C0F1C8;
"__imp__GetNearestPaletteIndex" = 0x00C0F1CC;
"__imp__SetBkMode" = 0x00C0F1D0;
"__imp__SetBkColor" = 0x00C0F1D4;
"__imp__CreateFontA" = 0x00C0F1D8;
"__imp__GetStockObject" = 0x00C0F1DC;
"__imp__SelectObject" = 0x00C0F1E0;
"__imp__SetTextColor" = 0x00C0F1E4;
"__imp__GetPixel" = 0x00C0F1E8;
"__imp__AddFontMemResourceEx" = 0x00C0F1EC;
"__imp__CreateDIBSection" = 0x00C0F1F0;
"__imp__GdiFlush" = 0x00C0F1F4;
"__imp__GetTextExtentPointW" = 0x00C0F1F8;
"__imp__RealizePalette" = 0x00C0F1FC;
"__imp__SelectPalette" = 0x00C0F200;
"__imp__CreateRectRgn" = 0x00C0F204;
"__imp__SetMapMode" = 0x00C0F208;
"__imp__CreateSolidBrush" = 0x00C0F20C;
"__imp__CreateFontIndirectW" = 0x00C0F210;
"__imp__GetDeviceCaps" = 0x00C0F214;
"__imp__GetObjectW" = 0x00C0F218;
"__imp__DeleteDC" = 0x00C0F21C;
"__imp__GetDIBits" = 0x00C0F220;
"__imp__CreateBrushIndirect" = 0x00C0F224;
"__imp__GetSystemPaletteEntries" = 0x00C0F228;
"__imp__LineTo" = 0x00C0F22C;
"__imp__BitBlt" = 0x00C0F230;
"__imp__LocalUnlock" = 0x00C0F238;
"__imp__LocalHandle" = 0x00C0F23C;
"__imp__GlobalReAlloc" = 0x00C0F240;
"__imp___lwrite" = 0x00C0F244;
"__imp__GlobalSize" = 0x00C0F248;
"__imp__OpenFile" = 0x00C0F24C;
"__imp__LocalFileTimeToFileTime" = 0x00C0F250;
"__imp__SystemTimeToFileTime" = 0x00C0F254;
"__imp__GetShortPathNameW" = 0x00C0F258;
"__imp__SetFileTime" = 0x00C0F25C;
"__imp__GetFileTime" = 0x00C0F260;
"__imp__GetTempFileNameW" = 0x00C0F264;
"__imp__GetTempPathW" = 0x00C0F268;
"__imp__CreatePipe" = 0x00C0F26C;
"__imp__PeekNamedPipe" = 0x00C0F270;
"__imp__CreateThread" = 0x00C0F274;
"__imp__DuplicateHandle" = 0x00C0F278;
"__imp__GetThreadPriority" = 0x00C0F27C;
"__imp__lstrlenA" = 0x00C0F280;
"__imp__SetThreadPriorityBoost" = 0x00C0F284;
"__imp__PulseEvent" = 0x00C0F288;
"__imp__CreateEventA" = 0x00C0F28C;
"__imp__CreateSemaphoreA" = 0x00C0F290;
"__imp__InterlockedCompareExchange" = 0x00C0F294;
"__imp__HeapReAlloc" = 0x00C0F298;
"__imp__SetEndOfFile" = 0x00C0F29C;
"__imp__WriteConsoleW" = 0x00C0F2A0;
"__imp__GetConsoleOutputCP" = 0x00C0F2A4;
"__imp__WriteConsoleA" = 0x00C0F2A8;
"__imp__SetEnvironmentVariableA" = 0x00C0F2AC;
"__imp__SetStdHandle" = 0x00C0F2B0;
"__imp__HeapCreate" = 0x00C0F2B4;
"__imp__HeapDestroy" = 0x00C0F2B8;
"__imp__GetEnvironmentStringsW" = 0x00C0F2BC;
"__imp__FreeEnvironmentStringsW" = 0x00C0F2C0;
"__imp__GetEnvironmentStrings" = 0x00C0F2C4;
"__imp__FreeEnvironmentStringsA" = 0x00C0F2C8;
"__imp__CompareStringW" = 0x00C0F2CC;
"__imp___lopen" = 0x00C0F2D0;
"__imp__GetStringTypeW" = 0x00C0F2D4;
"__imp__GetStringTypeA" = 0x00C0F2D8;
"__imp__IsValidLocale" = 0x00C0F2DC;
"__imp__EnumSystemLocalesA" = 0x00C0F2E0;
"__imp__GetLocaleInfoA" = 0x00C0F2E4;
"__imp__GetFileAttributesA" = 0x00C0F2E8;
"__imp__SetFilePointer" = 0x00C0F2EC;
"__imp__GetFileType" = 0x00C0F2F0;
"__imp__SetHandleCount" = 0x00C0F2F4;
"__imp__GetConsoleMode" = 0x00C0F2F8;
"__imp__GetConsoleCP" = 0x00C0F2FC;
"__imp__InterlockedExchange" = 0x00C0F300;
"__imp__SetConsoleCtrlHandler" = 0x00C0F304;
"__imp__LCMapStringW" = 0x00C0F308;
"__imp__LCMapStringA" = 0x00C0F30C;
"__imp__IsValidCodePage" = 0x00C0F310;
"__imp__GetOEMCP" = 0x00C0F314;
"__imp__GetCPInfo" = 0x00C0F318;
"__imp__FatalAppExitA" = 0x00C0F31C;
"__imp__GetModuleFileNameA" = 0x00C0F320;
"__imp__GetStdHandle" = 0x00C0F324;
"__imp__FlushFileBuffers" = 0x00C0F328;
"__imp__GetFullPathNameW" = 0x00C0F32C;
"__imp__RemoveDirectoryW" = 0x00C0F330;
"__imp__ExitThread" = 0x00C0F334;
"__imp__GetStartupInfoA" = 0x00C0F338;
"__imp__GetProcessHeap" = 0x00C0F33C;
"__imp__HeapAlloc" = 0x00C0F340;
"__imp__GetVersionExA" = 0x00C0F344;
"__imp__HeapFree" = 0x00C0F348;
"__imp__GetCommandLineA" = 0x00C0F34C;
"__imp__GetDateFormatA" = 0x00C0F350;
"__imp__GetTimeFormatA" = 0x00C0F354;
"__imp__MoveFileA" = 0x00C0F358;
"__imp__RtlUnwind" = 0x00C0F35C;
"__imp__GetTimeZoneInformation" = 0x00C0F360;
"__imp__IsDebuggerPresent" = 0x00C0F364;
"__imp__UnhandledExceptionFilter" = 0x00C0F368;
"__imp__FindNextFileA" = 0x00C0F36C;
"__imp__FindFirstFileA" = 0x00C0F370;
"__imp__ExitProcess" = 0x00C0F374;
"__imp__GetModuleHandleA" = 0x00C0F378;
"__imp__SetCurrentDirectoryA" = 0x00C0F37C;
"__imp__GetCurrentDirectoryA" = 0x00C0F380;
"__imp__GetFullPathNameA" = 0x00C0F384;
"__imp__GetDriveTypeA" = 0x00C0F388;
"__imp___lread" = 0x00C0F38C;
"__imp___llseek" = 0x00C0F390;
"__imp___lclose" = 0x00C0F394;
"__imp__GetWindowsDirectoryW" = 0x00C0F398;
"__imp__LoadResource" = 0x00C0F39C;
"__imp__LockResource" = 0x00C0F3A0;
"__imp__SizeofResource" = 0x00C0F3A4;
"__imp__GetPrivateProfileStringW" = 0x00C0F3A8;
"__imp__WritePrivateProfileStringW" = 0x00C0F3AC;
"__imp__WriteProfileStringW" = 0x00C0F3B0;
"__imp__FatalAppExitW" = 0x00C0F3B4;
"__imp__GlobalMemoryStatus" = 0x00C0F3B8;
"__imp__OpenProcess" = 0x00C0F3BC;
"__imp__GetExitCodeProcess" = 0x00C0F3C0;
"__imp__SetEnvironmentVariableW" = 0x00C0F3C4;
"__imp__GetDiskFreeSpaceW" = 0x00C0F3C8;
"__imp__GetProfileStringW" = 0x00C0F3CC;
"__imp__GetEnvironmentVariableW" = 0x00C0F3D0;
"__imp__GetComputerNameW" = 0x00C0F3D4;
"__imp__FindResourceW" = 0x00C0F3D8;
"__imp__OutputDebugStringW" = 0x00C0F3DC;
"__imp__SetThreadLocale" = 0x00C0F3E0;
"__imp__GetLocaleInfoW" = 0x00C0F3E4;
"__imp__GetACP" = 0x00C0F3E8;
"__imp__GetUserDefaultLCID" = 0x00C0F3EC;
"__imp__GetExitCodeThread" = 0x00C0F3F0;
"__imp__TerminateThread" = 0x00C0F3F4;
"__imp__TlsAlloc" = 0x00C0F3F8;
"__imp__TlsFree" = 0x00C0F3FC;
"__imp__TlsGetValue" = 0x00C0F400;
"__imp__ResumeThread" = 0x00C0F404;
"__imp__TlsSetValue" = 0x00C0F408;
"__imp__ReleaseSemaphore" = 0x00C0F40C;
"__imp__CreateSemaphoreW" = 0x00C0F410;
"__imp__ReleaseMutex" = 0x00C0F414;
"__imp__CreateMutexW" = 0x00C0F418;
"__imp__GetLogicalDriveStringsW" = 0x00C0F41C;
"__imp__GetDriveTypeW" = 0x00C0F420;
"__imp__SetErrorMode" = 0x00C0F424;
"__imp__SetCurrentDirectoryW" = 0x00C0F428;
"__imp__LoadLibraryW" = 0x00C0F42C;
"__imp__WideCharToMultiByte" = 0x00C0F430;
"__imp__MultiByteToWideChar" = 0x00C0F434;
"__imp__LocalAlloc" = 0x00C0F438;
"__imp__SetLastError" = 0x00C0F43C;
"__imp__ExpandEnvironmentStringsW" = 0x00C0F440;
"__imp__SetProcessAffinityMask" = 0x00C0F444;
"__imp__InitializeCriticalSection" = 0x00C0F448;
"__imp__VirtualQuery" = 0x00C0F44C;
"__imp__DeleteCriticalSection" = 0x00C0F450;
"__imp__VirtualFree" = 0x00C0F454;
"__imp__InitializeCriticalSectionAndSpinCount" = 0x00C0F458;
"__imp__VirtualAlloc" = 0x00C0F45C;
"__imp__LeaveCriticalSection" = 0x00C0F460;
"__imp__EnterCriticalSection" = 0x00C0F464;
"__imp__SetFilePointerEx" = 0x00C0F468;
"__imp__QueryPerformanceFrequency" = 0x00C0F46C;
"__imp__QueryPerformanceCounter" = 0x00C0F470;
"__imp__InterlockedDecrement" = 0x00C0F474;
"__imp__InterlockedIncrement" = 0x00C0F478;
"__imp__OutputDebugStringA" = 0x00C0F47C;
"__imp__FormatMessageA" = 0x00C0F480;
"__imp__RaiseException" = 0x00C0F484;
"__imp__LoadLibraryA" = 0x00C0F488;
"__imp__GetProcAddress" = 0x00C0F48C;
"__imp__ReplaceFileW" = 0x00C0F490;
"__imp__FindClose" = 0x00C0F494;
"__imp__FindNextFileW" = 0x00C0F498;
"__imp__FindFirstFileW" = 0x00C0F49C;
"__imp__MoveFileW" = 0x00C0F4A0;
"__imp__MoveFileExW" = 0x00C0F4A4;
"__imp__DeleteFileW" = 0x00C0F4A8;
"__imp__CreateDirectoryW" = 0x00C0F4AC;
"__imp__CopyFileW" = 0x00C0F4B0;
"__imp__CreateProcessA" = 0x00C0F4B4;
"__imp__GetFileAttributesW" = 0x00C0F4B8;
"__imp__CreateDirectoryA" = 0x00C0F4BC;
"__imp__DeleteFileA" = 0x00C0F4C0;
"__imp__GetNumaProcessorNode" = 0x00C0F4C4;
"__imp__GetSystemInfo" = 0x00C0F4C8;
"__imp__ResetEvent" = 0x00C0F4CC;
"__imp__GetNumaNodeProcessorMask" = 0x00C0F4D0;
"__imp__LocalFree" = 0x00C0F4D4;
"__imp__GetModuleHandleW" = 0x00C0F4D8;
"__imp__GetVersionExW" = 0x00C0F4DC;
"__imp__GlobalFree" = 0x00C0F4E0;
"__imp__SleepEx" = 0x00C0F4E4;
"__imp__GetModuleFileNameW" = 0x00C0F4E8;
"__imp__TerminateProcess" = 0x00C0F4EC;
"__imp__GetModuleHandleExW" = 0x00C0F4F0;
"__imp__FreeLibrary" = 0x00C0F4F4;
"__imp__SuspendThread" = 0x00C0F4F8;
"__imp__CreateToolhelp32Snapshot" = 0x00C0F4FC;
"__imp__Thread32Next" = 0x00C0F500;
"__imp__Thread32First" = 0x00C0F504;
"__imp__SetUnhandledExceptionFilter" = 0x00C0F508;
"__imp__CreateMutexA" = 0x00C0F50C;
"__imp__GetCurrentProcessId" = 0x00C0F510;
"__imp__GlobalLock" = 0x00C0F514;
"__imp__GlobalAlloc" = 0x00C0F518;
"__imp__WriteFile" = 0x00C0F51C;
"__imp__GlobalUnlock" = 0x00C0F520;
"__imp__WaitForSingleObject" = 0x00C0F524;
"__imp__CreateProcessW" = 0x00C0F528;
"__imp__SetThreadPriority" = 0x00C0F52C;
"__imp__GetSystemTimeAsFileTime" = 0x00C0F530;
"__imp__FormatMessageW" = 0x00C0F534;
"__imp__DosDateTimeToFileTime" = 0x00C0F538;
"__imp__GetOverlappedResult" = 0x00C0F53C;
"__imp__CreateFileA" = 0x00C0F540;
"__imp__ReadDirectoryChangesW" = 0x00C0F544;
"__imp__GetLastError" = 0x00C0F548;
"__imp__CancelIo" = 0x00C0F54C;
"__imp__GetFileSize" = 0x00C0F550;
"__imp__CreateFileMappingW" = 0x00C0F554;
"__imp__CreateFileW" = 0x00C0F558;
"__imp__GetFileAttributesExW" = 0x00C0F55C;
"__imp__ReadFile" = 0x00C0F560;
"__imp__UnmapViewOfFile" = 0x00C0F564;
"__imp__MapViewOfFile" = 0x00C0F568;
"__imp__FileTimeToLocalFileTime" = 0x00C0F56C;
"__imp__FileTimeToSystemTime" = 0x00C0F570;
"__imp__Sleep" = 0x00C0F574;
"__imp__SetEvent" = 0x00C0F578;
"__imp__CreateEventW" = 0x00C0F57C;
"__imp__SetThreadAffinityMask" = 0x00C0F580;
"__imp__GetProcessAffinityMask" = 0x00C0F584;
"__imp__GetCurrentThread" = 0x00C0F588;
"__imp__GetCurrentProcess" = 0x00C0F58C;
"__imp__CloseHandle" = 0x00C0F590;
"__imp__QueueUserAPC" = 0x00C0F594;
"__imp__GetCurrentThreadId" = 0x00C0F598;
"__imp__OpenThread" = 0x00C0F59C;
"__imp__GetTickCount" = 0x00C0F5A0;
"__imp__CompareStringA" = 0x00C0F5A4;
"__imp__DebugBreak" = 0x00C0F5A8;
"__imp__SHFileOperationW" = 0x00C0F5B0;
"__imp__SHGetFolderPathW" = 0x00C0F5B4;
"__imp__ShellExecuteExW" = 0x00C0F5B8;
"__imp__ShellExecuteW" = 0x00C0F5BC;
"__imp__SHFileOperationA" = 0x00C0F5C0;
"__imp__DragAcceptFiles" = 0x00C0F5C4;
"__imp__DragQueryPoint" = 0x00C0F5C8;
"__imp__DragFinish" = 0x00C0F5CC;
"__imp__DragQueryFileW" = 0x00C0F5D0;
"__imp__ExtractIconW" = 0x00C0F5D4;
"__imp__ExtractIconExW" = 0x00C0F5D8;
"__imp__SHGetPathFromIDListW" = 0x00C0F5DC;
"__imp__SHGetMalloc" = 0x00C0F5E0;
"__imp__SHBrowseForFolderW" = 0x00C0F5E4;
"__imp__PathFileExistsW" = 0x00C0F5EC;
"__imp__DdePostAdvise" = 0x00C0F5F4;
"__imp__DdeConnect" = 0x00C0F5F8;
"__imp__DdeCreateStringHandleW" = 0x00C0F5FC;
"__imp__DdeClientTransaction" = 0x00C0F600;
"__imp__DdeDisconnect" = 0x00C0F604;
"__imp__DdeInitializeW" = 0x00C0F608;
"__imp__DdeGetLastError" = 0x00C0F60C;
"__imp__DdeCreateDataHandle" = 0x00C0F610;
"__imp__DdeGetData" = 0x00C0F614;
"__imp__DdeFreeDataHandle" = 0x00C0F618;
"__imp__DdeQueryStringW" = 0x00C0F61C;
"__imp__DdeUninitialize" = 0x00C0F620;
"__imp__WaitForInputIdle" = 0x00C0F624;
"__imp__GetClipboardFormatNameW" = 0x00C0F628;
"__imp__RegisterClipboardFormatW" = 0x00C0F62C;
"__imp__EnumClipboardFormats" = 0x00C0F630;
"__imp__DrawStateW" = 0x00C0F634;
"__imp__DrawEdge" = 0x00C0F638;
"__imp__GetMenuItemCount" = 0x00C0F63C;
"__imp__GetMenuStringW" = 0x00C0F640;
"__imp__RedrawWindow" = 0x00C0F644;
"__imp__DefMDIChildProcW" = 0x00C0F648;
"__imp__TranslateMDISysAccel" = 0x00C0F64C;
"__imp__DefFrameProcW" = 0x00C0F650;
"__imp__SetTimer" = 0x00C0F654;
"__imp__KillTimer" = 0x00C0F658;
"__imp__SetScrollRange" = 0x00C0F65C;
"__imp__SetScrollPos" = 0x00C0F660;
"__imp__CreateIcon" = 0x00C0F664;
"__imp__UnionRect" = 0x00C0F668;
"__imp__DrawIconEx" = 0x00C0F66C;
"__imp__DrawFrameControl" = 0x00C0F670;
"__imp__ExitWindowsEx" = 0x00C0F674;
"__imp__wvsprintfW" = 0x00C0F678;
"__imp__MessageBeep" = 0x00C0F67C;
"__imp__EnumWindows" = 0x00C0F680;
"__imp__GetWindowThreadProcessId" = 0x00C0F684;
"__imp__GetClassNameW" = 0x00C0F688;
"__imp__GetWindowTextW" = 0x00C0F68C;
"__imp__MsgWaitForMultipleObjects" = 0x00C0F690;
"__imp__PostThreadMessageW" = 0x00C0F694;
"__imp__LoadIconW" = 0x00C0F698;
"__imp__CheckMenuRadioItem" = 0x00C0F69C;
"__imp__CheckMenuItem" = 0x00C0F6A0;
"__imp__DrawFocusRect" = 0x00C0F6A4;
"__imp__OffsetRect" = 0x00C0F6A8;
"__imp__CopyRect" = 0x00C0F6AC;
"__imp__MsgWaitForMultipleObjectsEx" = 0x00C0F6B0;
"__imp__DrawTextW" = 0x00C0F6B4;
"__imp__FillRect" = 0x00C0F6B8;
"__imp__ShowWindow" = 0x00C0F6BC;
"__imp__SetCursor" = 0x00C0F6C0;
"__imp__DestroyWindow" = 0x00C0F6C4;
"__imp__GetWindowLongW" = 0x00C0F6C8;
"__imp__InflateRect" = 0x00C0F6CC;
"__imp__GetUpdateRect" = 0x00C0F6D0;
"__imp__DrawIcon" = 0x00C0F6D4;
"__imp__SetMenu" = 0x00C0F6D8;
"__imp__SetForegroundWindow" = 0x00C0F6DC;
"__imp__GetSubMenu" = 0x00C0F6E0;
"__imp__CreateMenu" = 0x00C0F6E4;
"__imp__GetMenuState" = 0x00C0F6E8;
"__imp__InsertMenuW" = 0x00C0F6EC;
"__imp__RemoveMenu" = 0x00C0F6F0;
"__imp__ModifyMenuW" = 0x00C0F6F4;
"__imp__DestroyMenu" = 0x00C0F6F8;
"__imp__CreatePopupMenu" = 0x00C0F6FC;
"__imp__SetMenuItemInfoW" = 0x00C0F700;
"__imp__GetWindowTextLengthW" = 0x00C0F704;
"__imp__keybd_event" = 0x00C0F708;
"__imp__TranslateMessage" = 0x00C0F70C;
"__imp__DispatchMessageW" = 0x00C0F710;
"__imp__LoadBitmapW" = 0x00C0F714;
"__imp__GetMessageW" = 0x00C0F718;
"__imp__CreateDialogIndirectParamW" = 0x00C0F71C;
"__imp__RegisterClassW" = 0x00C0F720;
"__imp__UnregisterClassW" = 0x00C0F724;
"__imp__SetWindowRgn" = 0x00C0F728;
"__imp__AdjustWindowRectEx" = 0x00C0F72C;
"__imp__EnableMenuItem" = 0x00C0F730;
"__imp__DrawMenuBar" = 0x00C0F734;
"__imp__GetDesktopWindow" = 0x00C0F738;
"__imp__IsZoomed" = 0x00C0F73C;
"__imp__PostMessageW" = 0x00C0F740;
"__imp__EndPaint" = 0x00C0F744;
"__imp__BeginPaint" = 0x00C0F748;
"__imp__GetWindowDC" = 0x00C0F74C;
"__imp__CreateDialogParamW" = 0x00C0F750;
"__imp__LoadCursorW" = 0x00C0F754;
"__imp__LoadImageW" = 0x00C0F758;
"__imp__DialogBoxParamW" = 0x00C0F75C;
"__imp__EndDialog" = 0x00C0F760;
"__imp__SetWindowLongW" = 0x00C0F764;
"__imp__GetDlgItem" = 0x00C0F768;
"__imp__SetWindowTextW" = 0x00C0F76C;
"__imp__EnableWindow" = 0x00C0F770;
"__imp__SetDlgItemTextW" = 0x00C0F774;
"__imp__UnhookWindowsHookEx" = 0x00C0F778;
"__imp__CallNextHookEx" = 0x00C0F77C;
"__imp__OpenClipboard" = 0x00C0F780;
"__imp__EmptyClipboard" = 0x00C0F784;
"__imp__SetWindowsHookExW" = 0x00C0F788;
"__imp__SetClipboardData" = 0x00C0F78C;
"__imp__MessageBoxW" = 0x00C0F790;
"__imp__GetClipboardData" = 0x00C0F794;
"__imp__CloseClipboard" = 0x00C0F798;
"__imp__IsClipboardFormatAvailable" = 0x00C0F79C;
"__imp__GetWindowRect" = 0x00C0F7A0;
"__imp__SendMessageW" = 0x00C0F7A4;
"__imp__GetKeyState" = 0x00C0F7A8;
"__imp__GetForegroundWindow" = 0x00C0F7AC;
"__imp__ReleaseCapture" = 0x00C0F7B0;
"__imp__SetCapture" = 0x00C0F7B4;
"__imp__SetFocus" = 0x00C0F7B8;
"__imp__GetCursorPos" = 0x00C0F7BC;
"__imp__SetCursorPos" = 0x00C0F7C0;
"__imp__DestroyIcon" = 0x00C0F7C4;
"__imp__CreateIconIndirect" = 0x00C0F7C8;
"__imp__ReleaseDC" = 0x00C0F7CC;
"__imp__GetDC" = 0x00C0F7D0;
"__imp__ShowCursor" = 0x00C0F7D4;
"__imp__GetMonitorInfoW" = 0x00C0F7D8;
"__imp__MessageBoxA" = 0x00C0F7DC;
"__imp__MonitorFromPoint" = 0x00C0F7E0;
"__imp__ClipCursor" = 0x00C0F7E4;
"__imp__SystemParametersInfoW" = 0x00C0F7E8;
"__imp__SetWindowPos" = 0x00C0F7EC;
"__imp__GetSystemMenu" = 0x00C0F7F0;
"__imp__IsIconic" = 0x00C0F7F4;
"__imp__GetSystemMetrics" = 0x00C0F7F8;
"__imp__AppendMenuW" = 0x00C0F7FC;
"__imp__GetClassInfoW" = 0x00C0F800;
"__imp__GetClientRect" = 0x00C0F804;
"__imp__BringWindowToTop" = 0x00C0F808;
"__imp__PtInRect" = 0x00C0F80C;
"__imp__GetScrollPos" = 0x00C0F810;
"__imp__GetScrollRange" = 0x00C0F814;
"__imp__SetScrollInfo" = 0x00C0F818;
"__imp__ScrollWindow" = 0x00C0F81C;
"__imp__GetParent" = 0x00C0F820;
"__imp__DdeNameService" = 0x00C0F824;
"__imp__WindowFromPoint" = 0x00C0F828;
"__imp__SetParent" = 0x00C0F82C;
"__imp__InvalidateRect" = 0x00C0F830;
"__imp__UpdateWindow" = 0x00C0F834;
"__imp__ScreenToClient" = 0x00C0F838;
"__imp__ClientToScreen" = 0x00C0F83C;
"__imp__MoveWindow" = 0x00C0F840;
"__imp__PostQuitMessage" = 0x00C0F844;
"__imp__PeekMessageW" = 0x00C0F848;
"__imp__TrackPopupMenu" = 0x00C0F84C;
"__imp__DefWindowProcW" = 0x00C0F850;
"__imp__CallWindowProcW" = 0x00C0F854;
"__imp__GetUpdateRgn" = 0x00C0F858;
"__imp__IsWindowEnabled" = 0x00C0F85C;
"__imp__IsWindowVisible" = 0x00C0F860;
"__imp__ChildWindowFromPoint" = 0x00C0F864;
"__imp__CreateCursor" = 0x00C0F868;
"__imp__DestroyCursor" = 0x00C0F86C;
"__imp__GetIconInfo" = 0x00C0F870;
"__imp__TranslateAcceleratorW" = 0x00C0F874;
"__imp__CreateAcceleratorTableW" = 0x00C0F878;
"__imp__LoadAcceleratorsW" = 0x00C0F87C;
"__imp__DestroyAcceleratorTable" = 0x00C0F880;
"__imp__CreateWindowExW" = 0x00C0F884;
"__imp__GetSysColor" = 0x00C0F888;
"__imp__IsDialogMessageW" = 0x00C0F88C;
"__imp__IsWindow" = 0x00C0F890;
"__imp__GetCapture" = 0x00C0F894;
"__imp__GetFocus" = 0x00C0F898;
"__imp__GetMessagePos" = 0x00C0F89C;
"__imp__GetWindow" = 0x00C0F8A0;
"__imp__GetActiveWindow" = 0x00C0F8A4;
"__imp__GetScrollInfo" = 0x00C0F8A8;
"__imp__ChildWindowFromPointEx" = 0x00C0F8AC;
"__imp__timeEndPeriod" = 0x00C0F8B4;
"__imp__timeBeginPeriod" = 0x00C0F8B8;
"__imp__timeSetEvent" = 0x00C0F8BC;
"__imp__timeKillEvent" = 0x00C0F8C0;
"__imp__X3DAudioCalculate(x,x,x,x,x)" = 0x00C0F968;
"__imp__X3DAudioInitialize(x,x,x)" = 0x00C0F96C;
"__imp__PrintDlgW" = 0x00C0F974;
"__imp__GetSaveFileNameW" = 0x00C0F978;
"__imp__ChooseFontW" = 0x00C0F97C;
"__imp__CommDlgExtendedError" = 0x00C0F980;
"__imp__ChooseColorW" = 0x00C0F984;
"__imp__GetOpenFileNameW" = 0x00C0F988;
"__imp__Direct3DCreate9" = 0x00C0F990;
"_D3DXFloat32To16Array" = 0x00AC65C0;
"_D3DXCreateTextureFromFileInMemoryEx" = 0x00AC65C6;
"_D3DXCreateVolumeTextureFromFileInMemoryEx" = 0x00AC65CC;
"_D3DXCreateCubeTextureFromFileInMemoryEx" = 0x00AC65D2;
"_D3DXGetImageInfoFromFileInMemory" = 0x00AC65D8;
"_D3DXCreateTexture" = 0x00AC65DE;
"_D3DXLoadSurfaceFromSurface" = 0x00AC65E4;
"_D3DXSaveSurfaceToFileA" = 0x00AC65EA;
"_D3DXSaveSurfaceToFileInMemory" = 0x00AC65F0;
"_D3DXCreateBuffer" = 0x00AC65F6;
"_D3DXSaveTextureToFileA" = 0x00AC65FC;
"_D3DXCreateEffect" = 0x00AC6602;
"_D3DXCreateEffectCompiler" = 0x00AC6608;
"_D3DXGetPixelShaderProfile" = 0x00AC660E;
"_D3DXGetVertexShaderProfile" = 0x00AC6614;
"_D3DXMatrixMultiply" = 0x00AC661A;
"_D3DXMatrixInverse" = 0x00AC6620;
"_D3DXMatrixRotationX" = 0x00AC6626;
"_D3DXMatrixRotationY" = 0x00AC662C;
"_D3DXMatrixRotationZ" = 0x00AC6632;
"_D3DXMatrixRotationAxis" = 0x00AC6638;
"_D3DXMatrixRotationQuaternion" = 0x00AC663E;
"_D3DXMatrixTranslation" = 0x00AC6644;
"_D3DXMatrixScaling" = 0x00AC664A;
"_D3DXMatrixLookAtRH" = 0x00AC6650;
"__imp__StackWalk" = 0x00C0FA00;
"__imp__SymInitialize" = 0x00C0FA04;
"__imp__SymGetModuleBase" = 0x00C0FA08;
"__imp__SymSetOptions" = 0x00C0FA0C;
"__imp__SymGetSymFromAddr" = 0x00C0FA10;
"__imp__SymFunctionTableAccess" = 0x00C0FA14;
"__imp__SymCleanup" = 0x00C0FA18;
"__imp__UnDecorateSymbolName" = 0x00C0FA1C;
"__imp__SymGetLineFromAddr" = 0x00C0FA20;
"__imp__ReportFault" = 0x00C0FA28;
"__imp__RegisterDragDrop" = 0x00C0FA30;
"__imp__OleInitialize" = 0x00C0FA34;
"__imp__CoInitialize" = 0x00C0FA38;
"__imp__CoCreateInstance" = 0x00C0FA3C;
"__imp__CoLockObjectExternal" = 0x00C0FA40;
"__imp__RevokeDragDrop" = 0x00C0FA44;
"__imp__OleSetClipboard" = 0x00C0FA48;
"__imp__OleFlushClipboard" = 0x00C0FA4C;
"__imp__ReleaseStgMedium" = 0x00C0FA50;
"__imp__OleGetClipboard" = 0x00C0FA54;

SECTIONS {
  . = __image_base__ + 0x1000;
  .text : {
    *(.text*)
    *(.data*)
    *(.bss*)
    *(.rdata)
  }
  /DISCARD/ : {
    *(.rdata$zzz)
    *(.eh_frame*)
    *(.ctors)
    *(.reloc)
    *(.idata*)
  }
}